## conf/layer.conf
```bitbake
BBPATH ?= ""
# We have a conf and classes directory, add to BBPATH
BBPATH := "${LAYERDIR}:${BBPATH}"

# We have an images and various recipe-* directories, add to BBFILES
BBFILES += "${LAYERDIR}/recipes*/*/*.bb ${LAYERDIR}/recipes*/*/*.bbappend"

BBFILE_COLLECTIONS += "cgl-montavista"
BBFILE_PATTERN_cgl-montavista := "^${LAYERDIR}/"
BBFILE_PRIORITY_cgl-montavista = "7"
LAYERSERIES_COMPAT_cgl-montavista = "dunfell"

LAYERDEPENDS_cgl-montavista = "core"
LAYERDEPENDS_cgl-montavista += "cgx-montavista"
LAYERDEPENDS_cgl-montavista += "openembedded-layer"
LAYERDEPENDS_cgl-montavista += "filesystems-layer"
LAYERDEPENDS_cgl-montavista += "perl-layer"
LAYERDEPENDS_cgl-montavista += "gnome-layer"
LAYERDEPENDS_cgl-montavista += "multimedia-layer"
LAYERDEPENDS_cgl-montavista += "xfce-layer"
LAYERDEPENDS_cgl-montavista += "selinux"
LAYERDEPENDS_cgl-montavista += "security"

CGX_PROFILES_append_mvista-cgx += "cgl"

BBFILES_DYNAMIC += " \
   openembedded-layer:${LAYERDIR}/dynamic-layers/openembedded-layer/*/*/*.bbappend \
   openembedded-layer:${LAYERDIR}/dynamic-layers/openembedded-layer/*/*/*.bb \
   networking-layer:${LAYERDIR}/dynamic-layers/networking-layer/*/*/*.bbappend \
   security:${LAYERDIR}/dynamic-layers/security/*/*/*.bbappend \
   openstack-layer:${LAYERDIR}/dynamic-layers/openstack-layer/*/*/*.bbappend \
   virtualization-layer:${LAYERDIR}/dynamic-layers/virtualization-layer/*/*/*.bbappend \
   perl-layer:${LAYERDIR}/dynamic-layers/perl-layer/*/*/*.bbappend \
   cgl-common:${LAYERDIR}/dynamic-layers/cgl-common/*/*/*.bbappend \
   selinux:${LAYERDIR}/dynamic-layers/selinux/*/*/*.bbappend \
"

INHERIT += "sanity-meta-montavista-cgl"
```
